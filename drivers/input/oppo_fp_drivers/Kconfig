## drivers/input/oppo_fp_drivers/Kconfig
```kconfig
menuconfig OPPO_FINGERPRINT
	bool "OPPO fingerprint"
	depends on SPI_MASTER
	help
	  Say Y here to enable OPPO fingerprint support
```

## drivers/staging/android/kernelsu/Kconfig
```kconfig
config KSU
	tristate "KernelSU function support"
	depends on OVERLAY_FS
	help
	  Enable kernel-level root privileges on Android System.
	  To compile as a module, choose M here: the
	  module will be called kernelsu.

config KSU_DEBUG
	bool "KernelSU debug mode"
	depends on KSU
	help
	  Enable KernelSU debug mode.
```

## kernel/Kconfig.hz
```kconfig
#
# Timer Interrupt Frequency Configuration
#

config HZ
	int "Timer Frequency"
	default 100
	range 50 1000
	help
	  Allows the configuration of the timer frequency. It is customary
	  to have the timer interrupt run at 1000 Hz but 100 Hz may be more
	  beneficial for servers and NUMA systems that do not need to have
	  a fast response for user interaction and that may experience bus
	  contention and cacheline bounces as a result of timer interrupts.
	  Note that the timer interrupt occurs on each processor in an SMP
	  environment leading to NR_CPUS * HZ number of timer interrupts
	  per second.

config SCHED_HRTICK
	def_bool HIGH_RES_TIMERS
```
